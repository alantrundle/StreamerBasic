## sdkconfig.defaults
```kconfig
##### ───── PSRAM / External RAM (IDF 4.4.x) ─────────────────────────────
CONFIG_SPIRAM=y
CONFIG_SPIRAM_USE_CAPS_ALLOC=y
CONFIG_SPIRAM_ALLOW_STACK_EXTERNAL_MEMORY=y
CONFIG_SPIRAM_USE_MALLOC=y
CONFIG_SPIRAM_IGNORE_NOTFOUND=y

##### ───── Bluetooth (Classic + Bluedroid) ──────────────────────────────
CONFIG_BT_ENABLED=y
CONFIG_BT_BLUEDROID_ENABLED=y
CONFIG_BT_CLASSIC_ENABLED=y
CONFIG_BT_BLE_ENABLED=y          # keep dual-mode controller for stability

# BT controller mode (IDF 4.4 uses this symbol)
CONFIG_BTDM_CTRL_MODE_BTDM=y
# (Some trees use the older name below; leaving commented as reference)
# CONFIG_BTDM_CONTROLLER_MODE_BTDM=y

##### ───── Profiles: A2DP Source + AVRCP CT/TG ──────────────────────────
CONFIG_BT_A2DP_ENABLE=y
CONFIG_BT_A2DP_SOURCE=y
CONFIG_BT_A2DP_SINK=n

CONFIG_BT_AVRC_ENABLED=y
CONFIG_BT_AVRC_CT_ENABLED=y
CONFIG_BT_AVRC_TG_ENABLED=y

##### ───── Coexistence (Wi-Fi + BT) ─────────────────────────────────────
# Correct symbols for IDF 4.4.x:
CONFIG_SW_COEXIST_ENABLE=y
CONFIG_ESP32_WIFI_SW_COEXIST_ENABLE=y

##### ───── BT stack tuning (safe defaults) ──────────────────────────────
CONFIG_BT_BTC_TASK_STACK_SIZE=8096
CONFIG_BT_BLUEDROID_PINNED_TO_CORE=1
CONFIG_BT_SSP_ENABLED=n
CONFIG_BT_BREDR_SCO_DATA_PATH_EFF=0

CONFIG_BTDM_CTRL_SLEEP_MODE_NONE=y


# Optional log slimming (uncomment if you need more IRAM/DRAM)
CONFIG_BT_TRACE_ENABLED=n
CONFIG_LOG_DEFAULT_LEVEL_DEBUG=y
# CONFIG_BT_LOG_HCI_TRACE_LEVEL_NONE=y
# CONFIG_BT_LOG_BTC_TRACE_LEVEL_WARNING=y
# CONFIG_BT_LOG_BLUEDROID_TRACE_LEVEL_WARNING=y

##### ───── Arduino/FreeRTOS guards ──────────────────────────────────────
CONFIG_FREERTOS_UNICORE=n

configUSE_TRACE_FACILITY=0


# Reduce RX/TX buffers
CONFIG_ESP32_WIFI_STATIC_RX_BUFFER_NUM=6
CONFIG_ESP32_WIFI_DYNAMIC_RX_BUFFER_NUM=4
CONFIG_ESP32_WIFI_STATIC_TX_BUFFER_NUM=6
CONFIG_ESP32_WIFI_DYNAMIC_TX_BUFFER_NUM=4

# Reduce management buffers
CONFIG_ESP32_WIFI_RX_MGMT_BUF_NUM=4

CONFIG_ESP32_WIFI_RX_BUFFER_SIZE=800

CONFIG_ESP32_WIFI_AMPDU_RX_ENABLED=n
CONFIG_ESP32_WIFI_AMPDU_TX_ENABLED=n

CONFIG_ESP_WIFI_IRAM_OPT=n

CONFIG_LWIP_MAX_ACTIVE_TCP=4
CONFIG_LWIP_MAX_LISTENING_TCP=4
CONFIG_LWIP_TCP_SND_BUF_DEFAULT=8192
CONFIG_LWIP_TCP_WND_DEFAULT=8192
CONFIG_LWIP_TCP_RECVMBOX_SIZE=6
CONFIG_LWIP_TCP_ACCEPTMBOX_SIZE=4

CONFIG_ESP32_WIFI_ENABLE_WPA3_SAE=n
CONFIG_ESP32_WIFI_ENABLE_WPA3_H2E=n
CONFIG_ESP32_WIFI_ENABLE_WPS=n
CONFIG_ESP32_WIFI_ENABLE_WAPI=n
```
